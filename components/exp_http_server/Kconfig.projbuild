## components/exp_http_server/Kconfig.projbuild
```kconfig
menu "Expressif HTTP Server"
    config HTTP_SERVER_QUERY_VALUE_MAX_LEN
        int "The maximum length of a single query value (in bytes)"
        default 128

    config HTTP_SERVER_CHUNK_SIZE
        int "The default chunk size"
        default 128
endmenu
```

## components/exp_wifi/Kconfig.projbuild
```kconfig
menu "Expressif Wi-Fi"
    config ENABLE_IPV6
        bool "Whether use IPv6 or not"
        default y
        help
            Choose this option if you want to obtain IPv6 address.

    config WIFI_CONN_MAX_RETRY
        int "Wi-Fi max retry count"
        default 6
endmenu
```
